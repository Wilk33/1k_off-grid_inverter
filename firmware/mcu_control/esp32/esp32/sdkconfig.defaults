## firmware/mcu_control/esp32/esp32/sdkconfig.defaults
```kconfig
# Enable Bluetooth
CONFIG_BT_ENABLED=y
CONFIG_BTDM_CTRL_MODE_BLE_ONLY=n
CONFIG_BTDM_CTRL_MODE_BR_EDR_ONLY=y
CONFIG_BTDM_CTRL_MODE_BTDM=n

# SPP Profile
CONFIG_BT_SPP_ENABLED=y

# Classic Bluetooth settings
CONFIG_BT_CLASSIC_ENABLED=y
CONFIG_BT_A2DP_ENABLE=n
CONFIG_BT_HFP_ENABLE=n

# Flash size
CONFIG_ESPTOOLPY_FLASHSIZE_2MB=y
CONFIG_ESPTOOLPY_FLASHSIZE="2MB"
```
